## code/dongle/boards/custom/headphones_dongle/board.yml
```yaml
board:
  name: headphones_dongle
  full_name: Headphones USB dongle
  vendor: others
  socs:
    - name: nrf52840
```

## code/headset/boards/custom/headphones_headset/board.yml
```yaml
board:
  name: headphones_headset
  full_name: Headphones main PCB
  vendor: others
  socs:
    - name: nrf52840
```
